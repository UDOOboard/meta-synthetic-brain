## conf/layer.conf
```bitbake
# We have a conf and classes directory, add to BBPATH
BBPATH := "${BBPATH}:${LAYERDIR}"

# We have a recipes directory, add to BBFILES
BBFILES := "${BBFILES} ${LAYERDIR}/recipes-*/*/*.bb \
	        ${LAYERDIR}/recipes-*/*/*.bbappend"

BBFILE_COLLECTIONS += "synthetic-brain"
BBFILE_PATTERN_synthetic-brain:= "^${LAYERDIR}/"
BBFILE_PRIORITY_synthetic-brain = "10"
```
